#include <Arduino.h>
#include <Sprites.h>
#include <Print.h>
#include "Font3x6.h"

#define FONT3X6_WIDTH 3
#define FONT3X6_HEIGHT 6

#define CHAR_EXCLAMATION 33
#define CHAR_QUOTE 39
#define CHAR_PERIOD 46
#define CHAR_DASH 45
#define CHAR_PLUS 43
#define CHAR_QUESTION 63
#define CHAR_COLON 58
#define CHAR_AT 64
#define CHAR_COMMA 44
#define CHAR_LETTER_A 65
#define CHAR_LETTER_Z 90
#define CHAR_LETTER_A_LOWER 97
#define CHAR_LETTER_Z_LOWER 122
#define CHAR_NUMBER_0 48
#define CHAR_NUMBER_9 57

// #
#define CHAR_PRESS_A 35  
// $
#define CHAR_PRESS_B 36

#define FONT_EXCLAMATION_INDEX 62
#define FONT_PERIOD_INDEX 63
#define FONT_DASH_INDEX 64
#define FONT_PLUS_INDEX 65
#define FONT_QUESTION_INDEX 66
#define FONT_COLON_INDEX 67
#define FONT_AT_INDEX 68
#define FONT_COMMA_INDEX 69
#define FONT_QUOTE_INDEX 70
#define FONT_NUMBER_INDEX 52

const uint8_t PROGMEM font_images[] = {
  3, 8,

  0x00, 0x2F, 0x00,  // !
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  0x34, 0x24, 0x2C,  // z

};

const uint8_t PROGMEM PressAB[] = {
7, 8,
0x3c, 0x7e, 0xc3, 0xf5, 0xc3, 0x7e, 0x3c, 
0x3c, 0x7e, 0x81, 0xb5, 0xcb, 0x7e, 0x3c, 
};

Font3x6::Font3x6(uint8_t lineHeight) {

  _lineHeight = lineHeight;
  _letterSpacing = 1;

  _cursorX = _cursorY = _baseX = 0;
  _textColor = WHITE;

}

size_t Font3x6::write(uint8_t c) {

  if (c == '\n')     {
    _cursorX = _baseX;
    _cursorY += _lineHeight;
  }
  else if (c == ' ')      {
    _cursorX += 2;
  }
  else {

    printChar(c, _cursorX, _cursorY);
    if (c == 'i' || c == 'I' || c == '\'') {
      _cursorX += 2;
    }
    else if (c == 'l' || c == 'L') {
      _cursorX += 3;
    }
    else {
      _cursorX += FONT3X6_WIDTH + _letterSpacing;
    }

  }

  return 1;

}

void Font3x6::printChar(const char c, const int8_t x, int8_t y) {

  int8_t idx = -1;

  ++y;

  if (c == CHAR_PRESS_A) {
    idx = -3;
  }
  else if (c == CHAR_PRESS_B) {
    idx = -2;
  } 
  else {
    idx = c - CHAR_EXCLAMATION;
  }

  switch (idx) {

    case 0 ... 127:
      if (_textColor == WHITE) {
        SpritesB::drawSelfMasked(x, y, font_images, idx);
      }
      else {
        SpritesB::drawErase(x, y, font_images, idx);
      }
      break;

    case -3 ... -2:
      if (_textColor == WHITE) {
        SpritesB::drawSelfMasked(x, y - 1, PressAB, idx + 3);
      }
      else {
        SpritesB::drawErase(x, y - 1, PressAB, idx + 3);
      }
      break;

  }

}

void Font3x6::setCursor(const int8_t x, const int8_t y) {
  _cursorX = x;
  _baseX = x;
  _cursorY = y;
}

void Font3x6::setTextColor(const uint8_t color) {
  _textColor = color;
}

void Font3x6::setHeight(const uint8_t lineHeight) {
  _lineHeight = lineHeight;
}

